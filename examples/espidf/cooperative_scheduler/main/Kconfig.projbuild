## examples/espidf/cooperative_scheduler/main/Kconfig.projbuild
```kconfig
menu "APTA cooperative scheduler"

    config APTA_P4_HARDWARE_EVIDENCE
        bool "Build the APTA 1.1 physical USB/audio evidence harness"
        depends on IDF_TARGET_ESP32P4 && SPIRAM
        default n
        help
            Replace the generated-click diagnostic with the fail-closed,
            30-minute, 48 kHz USB UAC input harness. This option is for the
            pre-registered physical WP8 run only and requires the board's
            separate USB-OTG connector; USB Serial/JTAG is not audio input.

endmenu
```

## examples/espidf/cooperative_scheduler/sdkconfig.defaults
```kconfig
# SPDX-License-Identifier: Apache-2.0
CONFIG_COMPILER_OPTIMIZATION_SIZE=y
CONFIG_PARTITION_TABLE_SINGLE_APP_LARGE=y
CONFIG_ESP_MAIN_TASK_STACK_SIZE=8192
CONFIG_APTA_ESP_DSP_BACKEND=n
```

## ports/espidf/Kconfig
```kconfig
# SPDX-License-Identifier: Apache-2.0

menu "libapta-audio"

config APTA_ESP_DSP_BACKEND
    bool "Use ESP-DSP for port math helpers"
    default n
    help
        Use the optimized dsps_dotprod_f32 implementation from the official
        Espressif ESP-DSP component for apta_espidf_dot_product_f32().
        The portable libapta core remains algorithmically identical and does
        not require ESP-DSP.

config APTA_EXPERIMENTAL_MULTIBAND_ONSET
    bool "Enable experimental three-band onset novelty"
    default n
    help
        Build the phase-6 B3 onset experiment. The production default remains
        the established broadband novelty path until a real-audio corpus and
        target performance measurement justify promotion.

config APTA_OVERVIEW_FRAMES_PER_COLUMN
    int "Overview waveform frames per column"
    default 1024
    range 64 65536
    help
        Frames summarised into one overview waveform column. 1024 gives about
        43 columns per second at 44.1 kHz. Lowering it raises the horizontal
        resolution a zoom UI can draw, and raises the static workspace
        proportionally, because the accumulator array holds one entry per
        column across the whole track. Query the resulting requirement with
        apta_query_workspace_requirements() rather than guessing.

config APTA_MAX_DETAIL_TILES
    int "Detail waveform tile cache size"
    default 4
    range 1 64
    help
        Number of cached detail tiles. At the default detail geometry each
        tile covers 0.37 s at 44.1 kHz, so the default of 4 gives about 1.5 s
        of total detail coverage.

config APTA_ONSET_BIN_CAPACITY
    int "Onset bin ring capacity for local tempo"
    default 4096
    range 512 65536
    help
        Onset bins retained for the local tempo estimator. 4096 bins of 256
        frames is a 23.8 s analysis window at 44.1 kHz. Must be at least the
        minimum tempo window; a static assertion enforces this.

config APTA_GLOBAL_BIN_CAPACITY
    int "Global bin ring capacity for the global grid"
    default 16384
    range 1024 262144
    help
        Onset bins retained for the global beatgrid. 16384 bins of 2048 frames
        is a 12.7 minute ceiling at 44.1 kHz; tracks longer than that are
        analysed over a moving window. Raising it also raises the stack used
        by the refresh, which declares a per-window array sized from this
        value -- see the stack note in this port's README.

endmenu
```
